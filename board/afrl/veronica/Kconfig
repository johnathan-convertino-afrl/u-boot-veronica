## board/afrl/veronica/Kconfig
```kconfig
if TARGET_AFRL_VERONICA

config SYS_BOARD
	default "veronica"

config SYS_VENDOR
	default "afrl"
	
config SYS_CPU
	default "generic"

config SYS_CONFIG_NAME
	default "afrl_veronica"
	
config TEXT_BASE
	default 0x80400000 if SPL
	default 0x80000000 if !RISCV_SMODE
	default 0x80400000 if RISCV_SMODE

config SPL_TEXT_BASE
	default 0x08000000

config SPL_OPENSBI_LOAD_ADDR
	default 0x80000000
	
config BOARD_SPECIFIC_OPTIONS # dummy
	def_bool y
	select GENERIC_RISCV
# 	select SUPPORT_SPL
# 	select BINMAN

endif
```

## configs/afrl_veronica_defconfig
```kconfig
CONFIG_RISCV=y
CONFIG_CMD_CPU=y
CONFIG_CPU=y
CONFIG_SYS_MALLOC_LEN=0x800000
CONFIG_SYS_MALLOC_F_LEN=0x3000
CONFIG_NR_DRAM_BANKS=1
CONFIG_DEFAULT_DEVICE_TREE="afrl_veronica"
# CONFIG_HAS_CUSTOM_SYS_INIT_SP_ADDR=y
# CONFIG_CUSTOM_SYS_INIT_SP_ADDR=0x80400000
CONFIG_SYS_LOAD_ADDR=0x80400000
CONFIG_HAVE_TEXT_BASE=y
CONFIG_TARGET_AFRL_VERONICA=y
CONFIG_ARCH_RV32I=y
CONFIG_RISCV_SMODE=y
CONFIG_FIT=y
CONFIG_DISTRO_DEFAULTS=y
CONFIG_USE_PREBOOT=y
CONFIG_DEFAULT_FDT_FILE="afrl_veronica.dtb"
CONFIG_SYS_CBSIZE=256
CONFIG_SYS_PBSIZE=276
CONFIG_DISPLAY_CPUINFO=y
CONFIG_DISPLAY_BOARDINFO=y
CONFIG_MISC_INIT_R=n
# CONFIG_SPL_MAX_SIZE=0x100000
# CONFIG_SPL_SHARES_INIT_SP_ADDR is not set
CONFIG_ENV_RELOC_GD_ENV_ADDR=y
CONFIG_SPI=y
CONFIG_DM_MTD=y
CONFIG_DM_SPI=y
CONFIG_ALTERA_SPI=y
CONFIG_SD_BOOT=y
CONFIG_XILINX_UARTLITE=y
CONFIG_MMC=y
CONFIG_DM_MMC=y
CONFIG_MMC_SPI=y
CONFIG_ENV_IS_IN_FAT=n
CONFIG_CMD_MMC=y
CONFIG_RISCV_ISA_F=n
CONFIG_ENV_FAT_INTERFACE="mmc"
CONFIG_ENV_FAT_DEVICE_AND_PART="0:1"
CONFIG_SYS_MMC_ENV_DEV=0
CONFIG_SYS_MMC_ENV_PART=1
CONFIG_BOOTSTD_DEFAULTS=n
CONFIG_BOOTMETH_SCRIPT=n
CONFIG_BOOTMETH_DISTRO=n
CONFIG_CMD_BOOTMETH=n
CONFIG_EFI_LOADER=n
CONFIG_BOOTCOMMAND="fatload mmc 0:1 0x80600000 BOOT.scr; source 0x80600000; run mmc_boot"
CONFIG_BOOTSTD_FULL=n
CONFIG_MMC_SPI_CRC_ON=n
```
